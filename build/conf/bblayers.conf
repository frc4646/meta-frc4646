## build/conf/bblayers.conf
```bitbake
# Version of layers configuration, specific to
# each defined distro in the repository.
# Format: ${DISTRO}-<version>
TD_BBLAYERS_CONF_VERSION = "tegrademo-5"

BBPATH = "${TOPDIR}"
BBFILES ?= ""

BBLAYERS ?= " \
  ${TOPDIR}/../layers/meta \
  ${TOPDIR}/../layers/meta-tegra \
  ${TOPDIR}/../layers/meta-oe \
  ${TOPDIR}/../layers/meta-python \
  ${TOPDIR}/../layers/meta-networking \
  ${TOPDIR}/../layers/meta-filesystems \
  ${TOPDIR}/../layers/meta-virtualization \
  ${TOPDIR}/../layers/meta-tegra-community \
  ${TOPDIR}/../layers/meta-tegra-support \
  ${TOPDIR}/../layers/meta-demo-ci \
  ${TOPDIR}/../layers/meta-tegrademo \
  "
```

## layers/meta-tegrademo/conf/machine/jetson-orin-nano-som.conf
```bitbake
#@TYPE: Machine
#@NAME: Nvidia Jetson Orin Nano 8GB som on j401 board.
#@DESCRIPTION: Nvidia Jetson Orin Nano devkit using NVMe drive for rootfs

MACHINEOVERRIDES =. "jetson-orin-nano-8gb:"
TNSPEC_BOOTDEV ?= "nvme0n1p1"

require conf/machine/include/orin-nano-som.inc
```
